# file: PWM_ADC.ioc
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Mcu.Family=STM32C0
Mcu.Name=STM32C031C(4-6)Tx
Mcu.Package=LQFP48
PA13.GPIO_Label=DEBUG_SWDIO
PA13.Mode=Serial_Wire
PA13.Signal=DEBUG_SWDIO
PA14-BOOT0.Mode=Serial_Wire
PA14-BOOT0.Signal=DEBUG_SWCLK
PF0-OSC_IN\ (PF0).GPIO_Label=RCC_OSC_IN
PF0-OSC_IN\ (PF0).Mode=HSE-External-Oscillator
PF0-OSC_IN\ (PF0).Signal=RCC_OSC_IN
PF1-OSC_OUT\ (PF1).GPIO_Label=RCC_OSC_OUT
PF1-OSC_OUT\ (PF1).Mode=HSE-External-Oscillator
PF1-OSC_OUT\ (PF1).Signal=RCC_OSC_OUT
ProjectManager.HeapSize=0x200
ProjectManager.StackSize=0x400
ProjectManager.TargetToolchain=STM32CubeIDE
RCC.ADCFreq_Value=48000000
RCC.AHBFreq_Value=48000000
RCC.CortexFreq_Value=48000000
RCC.DATA_CACHE_ENABLE=0
RCC.EXTERNAL_CLOCK_VALUE=12288000
RCC.HCLKFreq_Value=48000000
RCC.HSE_VALUE=48000000
RCC.HSISYSCLKDivider=RCC_HSI_DIV1
RCC.HSI_VALUE=48000000
RCC.LSE_VALUE=32768
RCC.PREFETCH_ENABLE=1
RCC.SYSCLKFreq_VALUE=48000000
RCC.SYSCLKSource=RCC_SYSCLKSOURCE_HSE
board=NUCLEO-C031C6

// file: Core/Src/main.c
/* USER CODE BEGIN Header */
/**
  ******************************************************************************
  * @file           : main.c
  * @brief          : Main program body
  ******************************************************************************
  * @attention
  *
  * Copyright (c) 2025 STMicroelectronics.
  * All rights reserved.
  *
  * This software is licensed under terms that can be found in the LICENSE file
  * in the root directory of this software component.
  * If no LICENSE file comes with this software, it is provided AS-IS.
  *
  ******************************************************************************
  */
/* USER CODE END Header */
#include <adc_BSP.h>
#include "button_BSP.h"
#include "led_BSP.h"
#include "usart2_BSP.h"
#include "timer3_BSP.h"
#include "error_check_utilities.h"
#include "main.h"

/* USER CODE BEGIN PM */
#define PIN_0 0x0U
#define PIN_1 0x1U
#define PIN_2 0x2U
#define PIN_3 0x3U
#define PIN_4 0x4U
#define PIN_5 0x5U
#define PIN_6 0x6U
#define PIN_7 0x7U
#define PIN_8 0x8U
#define PIN_9 0x9U
#define PIN_10 0xAU
#define PIN_11 0xBU
#define PIN_12 0xCU
#define PIN_13 0xDU
#define PIN_14 0xEU
#define PIN_15 0xFU

#define MAX_ADC1_VALUE 4095 //ADC register has 12 bit resolution

#define CONVERT_ADC_TO_PWM(value)	(((unsigned long)(value) * 100UL) / MAX_ADC1_VALUE)

/* USER CODE END PM */

void SystemClock_Config(void);

int main(void)
{

  /* MCU Configuration--------------------------------------------------------*/

  /* Reset of all peripherals, Initializes the Flash interface and the Systick. */
  LL_APB2_GRP1_EnableClock(LL_APB2_GRP1_PERIPH_SYSCFG);
  LL_APB1_GRP1_EnableClock(LL_APB1_GRP1_PERIPH_PWR);

  /* SysTick_IRQn interrupt configuration */
  NVIC_SetPriority(SysTick_IRQn, 3);

  /* Configure the system clock */
  SystemClock_Config();

  /* Initialize all configured peripherals */
  /* USER CODE BEGIN 2 */

  LED_t boardLED;
  check_Error(initLED(&boardLED,GPIOA, PIN_5),__FILE__, __LINE__);

  check_Error(initUSART2(), __FILE__,__LINE__);

  check_Error(initCounter_Tmr3(1000), __FILE__,__LINE__);
  check_Error(initPWM_Tim3Ch1(), __FILE__,__LINE__);
  check_Error(setDutyCycle_Tim3Ch1(100U), __FILE__,__LINE__);
  check_Error(startCounter_Tmr3(), __FILE__,__LINE__);

  initADC_Ch0();

  printMsgNL_USART2("Nucleo Initialized!");

  __enable_irq();

  /* USER CODE END 2 */

  /* Infinite loop */
  /* USER CODE BEGIN WHILE */

  #define NUM_PWR_LVLS 5

  check_Error(turnOnLED(&boardLED), __FILE__,__LINE__);

  uint16_t adcData, pwmData;
  uint8_t convStatus = 0;
  while (1)
  {
	  check_Error(singleConvADC_Ch0(), __FILE__,__LINE__);
	  check_Error(readDataADC_Ch0(&adcData, &convStatus), __FILE__,__LINE__);

	  if(convStatus == 1){
		  check_Error(printMsgNL_USART2("ADC1 DATA: %u", adcData), __FILE__,__LINE__);

		  pwmData = CONVERT_ADC_TO_PWM(adcData);
		  check_Error(setDutyCycle_Tim3Ch1(pwmData), __FILE__,__LINE__);
	  }

	  check_Error(delayTicks_Tmr3(50), __FILE__,__LINE__);

    /* USER CODE END WHILE */

  }
}

void SystemClock_Config(void)
{
  LL_FLASH_EnablePrefetch();

  LL_FLASH_SetLatency(LL_FLASH_LATENCY_1);

  /* HSE configuration and activation */
  LL_RCC_HSE_Enable();
  while(LL_RCC_HSE_IsReady() != 1)
  {
  }

  /* Set AHB prescaler*/
  LL_RCC_SetAHBPrescaler(LL_RCC_HCLK_DIV_1);

  /* Sysclk activation on the HSE */
  LL_RCC_SetSysClkSource(LL_RCC_SYS_CLKSOURCE_HSE);
  while(LL_RCC_GetSysClkSource() != LL_RCC_SYS_CLKSOURCE_STATUS_HSE)
  {
  }

  /* Set APB1 prescaler*/
  LL_RCC_SetAPB1Prescaler(LL_RCC_APB1_DIV_1);
  LL_Init1msTick(48000000);
  /* Update CMSIS variable (which can be updated also through SystemCoreClockUpdate function) */
  LL_SetSystemCoreClock(48000000);
}

void Error_Handler(void)
{
  /* USER CODE BEGIN Error_Handler_Debug */
  /* User can add his own implementation to report the HAL error return state */
	Central_Error_Handler(E_ERROR_GENERIC, __FILE__, __LINE__);
  /* USER CODE END Error_Handler_Debug */
}
